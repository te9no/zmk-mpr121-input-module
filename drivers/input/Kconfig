## drivers/input/Kconfig
```kconfig
# Copyright (c) 2022 The ZMK Contributors
# SPDX-License-Identifier: MIT

menuconfig INPUT_MPR121
    bool "NXP MPR121 Capacitive Touch"
    default y
    depends on GPIO
    depends on I2C
    depends on INPUT
#    depends on DT_HAS_NXP_MPR121_ENABLED
    help
      Enable driver for NXP MPR121 based capacitive touch

if INPUT_MPR121

config INPUT_MPR121_INIT_PRIORITY
    int "NXP MPR121 initialization priority"
    default INPUT_INIT_PRIORITY

#if ZMK_MOUSE

config ZMK_INPUT_MPR121_IDLE_SLEEPER
    bool "NXP MPR121 Sleep linked to ZMK idle state"
    default n

#endif

endif
```

## dts/bindings/input/nxp,mpr121-common.yaml
```yaml
# Copyright (c) 2021 Nordic Semiconductor ASA
# SPDX-License-Identifier: Apache-2.0

description: |
  An integration for the NXP MPR121 capacitive touch sensor.

  Example definition in devicetree:

    mpr121 {
        compatible = "zephyr,mpr121";
        int-gpios = <&gpio0 0 (GPIO_PULL_UP | GPIO_ACTIVE_LOW)>;
    };

compatible: "zephyr,mpr121"

include: i2c-device.yaml

properties:
  int-gpio:
    type: phandle-array
    required: false
    description: Interrupt GPIO pin for the MPR121 device

  keymap:
    type: array
    required: false
    description: Array of key codes to be reported for each electrode
```
